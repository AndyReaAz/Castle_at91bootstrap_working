## configs/nextgen_nor_uboot_defconfig
```kconfig
CONFIG_MCK_BYPASS=y
CONFIG_HW_BANNER="\"\\n\\nCastle AT91Bootstrap \" AT91BOOTSTRAP_VERSION \" (\" COMPILE_TIME \")\\n\\n\""
CONFIG_DDR_SET_BY_DEVICE=y
CONFIG_DDR_AD210032F=y
CONFIG_SPI_BUS=1
CONFIG_SPI_CLK=50000000
CONFIG_IMG_SIZE="0x000a0000"
CONFIG_UBOOT_LENGTH_TRAILER=y
CONFIG_UBOOT_LENGTH_TRAILER_ADDRESS=0x0013fff0
CONFIG_UBOOT_MAX_SIZE=0x00137ff0
CONFIG_JUMP_ADDR="0x23f00000"
CONFIG_BOARD_QUIRK_SAMA5D2_SIP=y
```

## configs/nextgen_sd_uboot_timing_defconfig
```kconfig
CONFIG_MCK_BYPASS=y
# CONFIG_HW_DISPLAY_BANNER is not set
CONFIG_BOOT_TIMING_MARKERS=y
CONFIG_QUIET_SUCCESS=y
CONFIG_DDR_SET_BY_DEVICE=y
CONFIG_DDR_AD210032F=y
CONFIG_SDCARD=y
# CONFIG_SDHC_8BIT_SUPPORT is not set
CONFIG_MMC_NONREMOVABLE=y
CONFIG_JUMP_ADDR="0x23f00000"
CONFIG_BOARD_QUIRK_SAMA5D2_SIP=y
# CONFIG_FATFS_LONG_FILENAME is not set
```
